## boards/shields/pluto/Kconfig.defconfig
```kconfig
if SHIELD_PLUTO_LEFT

config ZMK_KEYBOARD_NAME
    default "Pluto"

config ZMK_SPLIT_ROLE_CENTRAL
    default y

endif

if SHIELD_PLUTO_LEFT || SHIELD_PLUTO_RIGHT

config ZMK_SPLIT
    default y

endif
```

## boards/shields/pluto/Kconfig.shield
```kconfig
config SHIELD_PLUTO_LEFT
    def_bool $(shields_list_contains,pluto_left)

config SHIELD_PLUTO_RIGHT
    def_bool $(shields_list_contains,pluto_right)
```
