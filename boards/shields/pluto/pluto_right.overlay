/*
 * Pluto - RIGHT half overlay
 *
 * The right PCB is a mirror of the left (Ergogen mirrors from matrix_sixth_num).
 * Physical columns left→right as seen from above on the RIGHT PCB:
 *   sixth (inner, closest to center) → first (outer, pinky side)
 *
 * These map to ZMK cols 6-11 via col-offset = 6.
 *
 *   col6  = sixth  P0.17 -> &gpio0 17
 *   col7  = fifth  P0.11 -> &gpio0 11
 *   col8  = fourth P1.00 -> &gpio1 0
 *   col9  = third  P0.24 -> &gpio0 24
 *   col10 = second P0.22 -> &gpio0 22
 *   col11 = first  P0.20 -> &gpio0 20
 *
 * Same physical nets as left half — the PCB is symmetric.
 */

#include "pluto.dtsi"

&default_transform {
    col-offset = <6>;
};

&kscan0 {
    col-gpios
        = <&gpio0 17 GPIO_ACTIVE_HIGH>   /* col6:  sixth  P0.17 (inner) */
        , <&gpio0 11 GPIO_ACTIVE_HIGH>   /* col7:  fifth  P0.11         */
        , <&gpio1  0 GPIO_ACTIVE_HIGH>   /* col8:  fourth P1.00         */
        , <&gpio0 24 GPIO_ACTIVE_HIGH>   /* col9:  third  P0.24         */
        , <&gpio0 22 GPIO_ACTIVE_HIGH>   /* col10: second P0.22         */
        , <&gpio0 20 GPIO_ACTIVE_HIGH>   /* col11: first  P0.20 (outer) */
        ;
};
