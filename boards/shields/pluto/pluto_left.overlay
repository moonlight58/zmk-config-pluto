/*
 * Pluto - LEFT half overlay
 *
 * Columns left→right on the physical left PCB:
 *   col0 = first  P0.20 -> &gpio0 20
 *   col1 = second P0.22 -> &gpio0 22
 *   col2 = third  P0.24 -> &gpio0 24
 *   col3 = fourth P1.00 -> &gpio1 0
 *   col4 = fifth  P0.11 -> &gpio0 11
 *   col5 = sixth  P0.17 -> &gpio0 17
 */

#include "pluto.dtsi"

&kscan0 {
    col-gpios
        = <&gpio0 20 GPIO_ACTIVE_HIGH>   /* col0: first  P0.20 */
        , <&gpio0 22 GPIO_ACTIVE_HIGH>   /* col1: second P0.22 */
        , <&gpio0 24 GPIO_ACTIVE_HIGH>   /* col2: third  P0.24 */
        , <&gpio1  0 GPIO_ACTIVE_HIGH>   /* col3: fourth P1.00 */
        , <&gpio0 11 GPIO_ACTIVE_HIGH>   /* col4: fifth  P0.11 */
        , <&gpio0 17 GPIO_ACTIVE_HIGH>   /* col5: sixth  P0.17 */
        ;
};
